## boards/shields/nicepillz/Kconfig.defconfig
```kconfig
# Copyright (c) 2020 The ZMK Contributors
# SPDX-License-Identifier: MIT

if SHIELD_NICEPILLZ

config ZMK_KEYBOARD_NAME
    default "Nice Pillz"

config SPI
    default y

if ZMK_DISPLAY

# nice!view (Sharp LS0xx 160x68 memory LCD) defaults, mirroring the
# upstream nice_view shield.
config LV_Z_VDB_SIZE
    default 100

config LV_DPI_DEF
    default 161

config LV_Z_BITS_PER_PIXEL
    default 1

choice LV_COLOR_DEPTH
    default LV_COLOR_DEPTH_1
endchoice

choice ZMK_DISPLAY_WORK_QUEUE
    default ZMK_DISPLAY_WORK_QUEUE_DEDICATED
endchoice

choice ZMK_DISPLAY_STATUS_SCREEN
    default ZMK_DISPLAY_STATUS_SCREEN_CUSTOM
endchoice

config LV_Z_MEM_POOL_SIZE
    default 8192

choice LV_FONT_DEFAULT
    default LV_FONT_DEFAULT_MONTSERRAT_12
endchoice

# Canvas drawing with the larger fonts needs a bit more stack than ZMK's default.
config ZMK_DISPLAY_DEDICATED_THREAD_STACK_SIZE
    default 4096

# Memory LCDs draw almost nothing, so keep the screen alive while idle.
config ZMK_DISPLAY_BLANK_ON_IDLE
    default n

config NICEPILLZ_STATUS_SCREEN
    bool "Nice Pillz portrait nice!view status screen"
    default y if ZMK_DISPLAY_STATUS_SCREEN_CUSTOM
    select LV_USE_IMG
    select LV_USE_CANVAS
    select LV_USE_LABEL
    select LV_DRAW_COMPLEX
    select LV_USE_THEME_MONO
    select LV_FONT_MONTSERRAT_8
    select LV_FONT_MONTSERRAT_10
    select LV_FONT_MONTSERRAT_12
    select LV_FONT_MONTSERRAT_22
    select ZMK_WPM

if NICEPILLZ_STATUS_SCREEN

config NICEPILLZ_DISPLAY_INVERTED
    bool "Draw white on black instead of black on white"

config NICEPILLZ_TIME_12H
    bool "Show the clock as 12-hour instead of 24-hour"

config NICEPILLZ_WPM_INTERVAL_MS
    int "Minimum time between WPM updates on the display (ms)"
    default 5000

config NICEPILLZ_TIME_SYNC
    bool "USB serial port for setting the clock from the host"
    default y
    depends on ZMK_USB
    select USB_DEVICE_STACK
    select USB_CDC_ACM
    select SERIAL
    select UART_INTERRUPT_DRIVEN

endif # NICEPILLZ_STATUS_SCREEN

endif # ZMK_DISPLAY

endif # SHIELD_NICEPILLZ
```
