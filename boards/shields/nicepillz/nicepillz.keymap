/*
 * SPDX-License-Identifier: MIT
 *
 * The keymap is config/nicepillz.keymap. This file only includes it, so a build that does not
 * set ZMK_CONFIG gets the same keymap.
 */

#include "../../../config/nicepillz.keymap"
